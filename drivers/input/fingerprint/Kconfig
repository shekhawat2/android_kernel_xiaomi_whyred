## drivers/input/fingerprint/Kconfig
```kconfig
menu "Fingerprint Drivers"

config INPUT_FINGERPRINT
	tristate "fingerprint driver support"
	help
	  say y here to enable fingerprint driver support!

endmenu

if INPUT_FINGERPRINT
source "drivers/input/fingerprint/fpc/Kconfig"
source "drivers/input/fingerprint/goodix/Kconfig"
endif
```

## drivers/input/fingerprint/fpc/Kconfig
```kconfig
config FINGERPRINT_FPC
    tristate "fpc fingerprint fpc1020"
    help 
        say y enable to enable fpc 1020 fingerprint
```

## drivers/input/fingerprint/goodix/Kconfig
```kconfig
config FINGERPRINT_GOODIX
    tristate "goodix fingerprint gf3258"
    help 
        say y enable to gf3258 goodix
```

## drivers/platform/xiaomi/Kconfig
```kconfig
config KERNEL_CUSTOM_E7S
	default n
	bool "Custom for hardware E7S_pcb"
	help
	  Custom for E7S_pcb.
```
